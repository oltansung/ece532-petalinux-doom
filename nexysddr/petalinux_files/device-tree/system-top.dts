/*
 * CAUTION: This file is automatically generated by Xilinx.
 * Version: XSCT 
 * Today is: Fri Mar 29 18:53:35 2024
 */


/dts-v1/;
#include "pl.dtsi"
/ {
	chosen {
		bootargs = "earlycon";
		stdout-path = "serial0:115200n8";
	};
	aliases {
		ethernet0 = &axi_ethernetlite_0;
		serial0 = &axi_uartlite_0;
		spi0 = &axi_quad_spi_0;
		spi1 = &axi_quad_spi_1;
	};
	memory@80000000 {
		device_type = "memory";
		reg = <0x80000000 0x8000000>;
	};
};
#include "system-user.dtsi"
